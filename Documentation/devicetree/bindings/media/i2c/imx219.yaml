## Documentation/devicetree/bindings/media/i2c/imx219.yaml
```yaml
# SPDX-License-Identifier: GPL-2.0
%YAML 1.2
---
$id: http://devicetree.org/schemas/media/i2c/imx219.yaml#
$schema: http://devicetree.org/meta-schemas/core.yaml#

title: Sony 1/4.0-Inch 8Mpixel CMOS Digital Image Sensor

maintainers:
  - Dave Stevenson <dave.stevenson@raspberrypi.com>

description: |-
  The Sony imx219 is a 1/4.0-inch CMOS active pixel digital image sensor
  with an active array size of 3280H x 2464V. It is programmable through
  I2C interface. The I2C address is fixed to 0x10 as per sensor data sheet.
  Image data is sent through MIPI CSI-2, which is configured as either 2 or
  4 data lanes.

properties:
  compatible:
    const: sony,imx219

  reg:
    maxItems: 1

  clocks:
    maxItems: 1

  clock-names:
    items:
      - const: xclk

  VDIG-supply:
    description:
      Digital I/O voltage supply, 1.8 volts

  VANA-supply:
    description:
      Analog voltage supply, 2.8 volts

  VDDL-supply:
    description:
      Digital core voltage supply, 1.2 volts

  xclr-gpios:
    description: |-
      Reference to the GPIO connected to the xclr pin, if any.
      Must be released after all supplies are applied.
      This is an active high signal to the imx219.

  clock-noncontinuous:
    description: |-
      Presence of this boolean property decides whether the MIPI CSI-2 clock
      is continuous or non-continuous.

  camera-clk: true

  port: true

  data-lanes:
    description: |-
      Should be <1 2 3 4> for four-lane operation, or <1 2> for two-lane
      operation.
    const: <1 2>
  clock-lanes:
    const: <0>

required:
  - compatible
  - reg
  - clocks
  - clock-names
  - VANA-supply
  - VDIG-supply
  - VDDL-supply

additionalProperties: false

examples:
  - |
    i2c0 {
        #address-cells = <1>;
        #size-cells = <0>;

        imx219: sensor@10 {
            compatible = "sony,imx219";
            reg = <0x10>;
            clocks = <&imx219_clk>;
            clock-names = "xclk";
            VANA-supply = <&imx219_vana>;   /* 2.8v */
            VDIG-supply = <&imx219_vdig>;   /* 1.8v */
            VDDL-supply = <&imx219_vddl>;   /* 1.2v */

            imx219_clk: camera-clk {
                compatible = "fixed-clock";
                #clock-cells = <0>;
                clock-frequency = <24000000>;
            };

            port {
                imx219_0: endpoint {
                    remote-endpoint = <&csi1_ep>;
                    clock-lanes = <0>;
                    data-lanes = <1 2>;
                    clock-noncontinuous;
                    bus-type = <4>;
                };
            };
        };
    };

...
```

## Documentation/devicetree/bindings/media/rpivid_hevc.txt
```
Device-tree bindings for the HEVC decoder block found on the Broadcom BCM2711
SoC, as used on the Raspberry Pi 4.

Required properties:
- compatible		: must be one of the following compatibles:
			- "raspberrypi,rpivid-vid-decoder"
- reg			: intc, hevc, h264, vp9
- reg-name		: intc, hevc, h264, vp9 registers
- interrupts		: should contain IRQ line for the block;

Example:

video-codec@7eb10000 {
	compatible = "raspberrypi,rpivid-vid-decoder";
	reg = <0x0 0x7eb10000 0x1000>,	/* INTC */
	      <0x0 0x7eb00000 0x10000>; /* HEVC */
	reg-names = "intc",
		    "hevc";

	interrupts = <GIC_SPI 98 IRQ_TYPE_LEVEL_HIGH>;
};
```
